## package/qt5/qtwayland/Config.in
```kconfig
config BR2_PACKAGE_QTWAYLAND
	bool "qtwayland"
	select BR2_PACKAGE_QT5BASE
	select BR2_PACKAGE_QT5BASE_GUI
	help
	  Qt is a cross-platform application and UI framework for
	  developers using C++.

	  This package corresponds to the qt5svg module.

	  http://qt-project.org
```
